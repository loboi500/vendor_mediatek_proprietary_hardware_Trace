;AP WDT disable
d.s asd:0x1C007000 %le %long 0x22000064

