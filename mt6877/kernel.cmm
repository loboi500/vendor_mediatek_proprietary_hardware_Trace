do project.cmm
; =========================================
; Please DO NOT modify this section - START
; =========================================
SYStem.Down
system.reset
SYSTEM.OPTION ENRESET ON
SYStem.Option ResBreak OFF
SYStem.Option WaitReset OFF
SYStem.JtagClock 10.MHz

SYStem.CPU ANANKE;

;Setting Core debug register access
SYSTEM.CONFIG CORENUMBER 8;
SYStem.CONFIG COREBASE 0x8e010000 0x8e110000 0x8e210000 0x8e310000 0x8e410000 0x8e510000 0x8e610000 0x8e710000;
SYStem.CONFIG CTIBASE  0x8e020000 0x8e120000 0x8e220000 0x8e320000 0x8e420000 0x8e520000 0x8e620000 0x8e720000;
CORE.ASSIGN 1 2 3 4 5 6 7 8


;; Parallel Interface
System.CONFIG SWDP OFF

SYStem.Up

SETUP.IMASKASM	ON          ; Disbale interrupt during assembly step
SETUP.IMASKHLL	ON          ; Disbale interrupt during C step

MMU.OFF

print "[INFO][MAIN] Watchdog Disabled"

do wdt.cmm  ; disable hw watchdog timer

Break.SELect Program OnChip ; set_hw_breakpoint_by_def   Jau add
Break.SELect Read OnChip
Break.SELect Write OnChip

Break.Delete
sYmbol.RESet

&KernelPATH="../../../../../../out/target/product/&project/obj/KERNEL_OBJ"
print "[INFO][MAIN] Loading Linux Kernel Symbols ..."
sYmbol.SourcePATH.RESet
&searchStr="/kernel-4.14/"
&alpsPath="../../../../../../kernel-4.14"
Data.LOAD.Elf &KernelPATH/vmlinux /gnu /nocode /StripPART "&searchStr" /PATH "&alpsPath"

;menu.reprogram Linux
;menu.reprogram watchdog

B::
TOOLBAR ON
;WINPAGE.RESET

WINPOS 0.125 0.125 100. 30. 13. 1. W000
WINTABS 16. 10. 25. 62.
;WINPAGE.SELECT P000


Break.Delete
B.set start_kernel
B.set smp_cpus_done

on pbreak gosub
(
	if data.long(asd:0x10007000)!=0x00000000
	(
		do wdt.cmm
		print "Watchdog disabled"
		return
	)
)

d.l
go

stop
end
